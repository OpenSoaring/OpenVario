## meta-ov/conf/layer.conf
```bitbake
# We have a conf and classes directory, add to BBPATH
BBPATH .= ":${LAYERDIR}"

# We have recipes-* directories, add to BBFILES
BBFILES += "${LAYERDIR}/recipes-*/*/*.bb \
            ${LAYERDIR}/recipes-*/*/*.bbappend"

BBFILE_COLLECTIONS += "meta-ov"
BBFILE_PATTERN_meta-ov = "^${LAYERDIR}/"
BBFILE_PRIORITY_meta-ov = "20"
LAYERVERSION_meta-ov = "5"
LAYERSERIES_COMPAT_meta-ov = "kirkstone"
```
